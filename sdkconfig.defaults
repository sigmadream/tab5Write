## sdkconfig.defaults
```kconfig
CONFIG_IDF_TARGET="esp32p4"
CONFIG_ESP32P4_SELECTS_REV_LESS_V3=y

# PSRAM 활성화
CONFIG_SPIRAM=y
CONFIG_SPIRAM_MODE_HEX=y

# Flash 크기 16MB
CONFIG_ESPTOOLPY_FLASHSIZE_16MB=y

# FATFS LFN heap 모드 활성화 (max 255)
CONFIG_FATFS_LFN_HEAP=y
CONFIG_FATFS_MAX_LFN=255

# FreeRTOS tick rate 1000Hz
CONFIG_FREERTOS_HZ=1000

# 파티션 테이블 커스텀
CONFIG_PARTITION_TABLE_CUSTOM=y
CONFIG_PARTITION_TABLE_CUSTOM_FILENAME="partitions.csv"


# 개발 캡처용 serial console 속도
CONFIG_ESPTOOLPY_MONITOR_BAUD=921600

# LVGL 설정
CONFIG_LV_FONT_FMT_TXT_LARGE=y
CONFIG_LV_USE_FONT_COMPRESSED=y
CONFIG_LV_BUILD_EXAMPLES=n
CONFIG_LV_BUILD_DEMOS=n
CONFIG_LV_USE_LOG=y
CONFIG_LV_USE_SNAPSHOT=y
CONFIG_LV_LOG_LEVEL_WARN=y
CONFIG_LV_LOG_PRINTF=y
CONFIG_LV_FONT_MONTSERRAT_20=y

CONFIG_BSP_LCD_DRAW_BUF_DOUBLE=n

# USB Host keyboard input
CONFIG_USB_HOST_HUBS_SUPPORTED=y
```
